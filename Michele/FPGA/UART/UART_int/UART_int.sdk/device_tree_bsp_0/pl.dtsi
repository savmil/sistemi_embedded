/*
 * CAUTION: This file is automatically generated by Xilinx.
 * Version: XSCT 2018.3
 * Today is: Wed May  1 19:54:48 2019
 */


/ {
	amba_pl: amba_pl {
		#address-cells = <1>;
		#size-cells = <1>;
		compatible = "simple-bus";
		ranges ;
		my_uart_int_0: my_uart_int@43c00000 {
			/* This is a place holder node for a custom IP, user may need to update the entries */
			clock-names = "s_axi_intr_aclk", "s00_axi_aclk";
			clocks = <&clkc 15>, <&clkc 15>;
			compatible = "xlnx,my-uart-int-1.0";
			interrupt-names = "irq";
			interrupt-parent = <&intc>;
			interrupts = <0 29 4>;
			reg = <0x43c00000 0x10000 0x43c10000 0x10000>;
			xlnx,intr-active-state = <0x7FFFFFFE>;
			xlnx,intr-sensitivity = <0x0FFFFFFC>;
			xlnx,irq-active-state = <0x1>;
			xlnx,irq-sensitivity = <0x1>;
			xlnx,num-of-intr = <0x2>;
			xlnx,s-axi-intr-addr-width = <0x5>;
			xlnx,s-axi-intr-data-width = <0x20>;
			xlnx,s00-axi-addr-width = <0x4>;
			xlnx,s00-axi-data-width = <0x20>;
		};
	};
};
